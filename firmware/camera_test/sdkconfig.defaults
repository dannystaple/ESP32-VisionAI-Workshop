## firmware/camera_test/sdkconfig.defaults
```kconfig
# Target
CONFIG_IDF_TARGET="esp32s3"

# Flash — board has 8MB
CONFIG_ESPTOOLPY_FLASHSIZE_8MB=y
CONFIG_ESPTOOLPY_FLASHSIZE="8MB"

# PSRAM — octal, 80 MHz (required for camera + inference)
CONFIG_ESP32S3_SPIRAM_SUPPORT=y
CONFIG_SPIRAM_MODE_OCT=y
CONFIG_SPIRAM_SPEED_80M=y
CONFIG_SPIRAM_MALLOC_ALWAYSINTERNAL=16384

# CPU: 240 MHz
CONFIG_ESP32S3_DEFAULT_CPU_FREQ_240=y

# Camera
CONFIG_CAMERA_MODULE_ESP_S3_EYE=y

# WiFi
CONFIG_ESP_WIFI_STATIC_RX_BUFFER_NUM=16
CONFIG_ESP_WIFI_DYNAMIC_RX_BUFFER_NUM=64
CONFIG_ESP_WIFI_TX_BUFFER=DYNAMIC
CONFIG_ESP_WIFI_DYNAMIC_TX_BUFFER_NUM=128

# LwIP — larger TCP send buffer reduces round-trips per JPEG frame
CONFIG_LWIP_TCP_SND_BUF_DEFAULT=65535
CONFIG_LWIP_TCP_WND_DEFAULT=65535
CONFIG_LWIP_TCP_RECVMBOX_SIZE=16
CONFIG_LWIP_UDP_RECVMBOX_SIZE=16

# HTTP server — larger buffers for MJPEG
CONFIG_HTTPD_MAX_RESP_HDR_LEN=1024
CONFIG_HTTPD_MAX_URI_LEN=512

# Stack sizes
CONFIG_ESP_MAIN_TASK_STACK_SIZE=8192
```

## firmware/lab_01/sdkconfig.defaults
```kconfig
# Target
CONFIG_IDF_TARGET="esp32s3"

# Flash — board has 8MB
CONFIG_ESPTOOLPY_FLASHSIZE_8MB=y
CONFIG_ESPTOOLPY_FLASHSIZE="8MB"

# PSRAM — octal, 80 MHz
CONFIG_ESP32S3_SPIRAM_SUPPORT=y
CONFIG_SPIRAM_MODE_OCT=y
CONFIG_SPIRAM_SPEED_80M=y
CONFIG_SPIRAM_MALLOC_ALWAYSINTERNAL=16384

# CPU: 240 MHz
CONFIG_ESP32S3_DEFAULT_CPU_FREQ_240=y

# Stack
CONFIG_ESP_MAIN_TASK_STACK_SIZE=8192
```

## firmware/lab_02/sdkconfig.defaults
```kconfig
# Target
CONFIG_IDF_TARGET="esp32s3"

# Flash — board has 8MB
CONFIG_ESPTOOLPY_FLASHSIZE_8MB=y
CONFIG_ESPTOOLPY_FLASHSIZE="8MB"

# PSRAM — octal, 80 MHz
CONFIG_ESP32S3_SPIRAM_SUPPORT=y
CONFIG_SPIRAM_MODE_OCT=y
CONFIG_SPIRAM_SPEED_80M=y
CONFIG_SPIRAM_MALLOC_ALWAYSINTERNAL=16384

# CPU: 240 MHz
CONFIG_ESP32S3_DEFAULT_CPU_FREQ_240=y

# Stack — larger for C++ TFLM inference task
CONFIG_ESP_MAIN_TASK_STACK_SIZE=8192

# C++ exceptions off — TFLM does not use them
CONFIG_COMPILER_CXX_EXCEPTIONS=n

# Allow allocation of large chunks in external RAM
CONFIG_SPIRAM_ALLOW_BSS_SEG_EXTERNAL_MEMORY=y

# Task watchdog: don't monitor CPU0 idle task — inference blocks it intentionally
CONFIG_ESP_TASK_WDT_CHECK_IDLE_TASK_CPU0=n
```
